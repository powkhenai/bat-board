## boards/shields/bat_board/Kconfig.defconfig
```kconfig
if SHIELD_BAT_BOARD_LEFT

config ZMK_KEYBOARD_NAME
    default "Bat Mobile"

config ZMK_SPLIT_ROLE_CENTRAL
    default y

config ZMK_SPLIT_BLE_CENTRAL_BATTERY_LEVEL_FETCHING
    default n

config ZMK_SPLIT_BLE_CENTRAL_BATTERY_LEVEL_PROXY
    default n

config ZMK_EXT_POWER
    default n

endif

if SHIELD_BAT_BOARD_LEFT || SHIELD_BAT_BOARD_RIGHT

config ZMK_SPLIT
    default y

endif
```

## boards/shields/bat_board/Kconfig.shield
```kconfig
config SHIELD_BAT_BOARD_LEFT
    def_bool $(shields_list_contains,bat_board_left)

config SHIELD_BAT_BOARD_RIGHT
    def_bool $(shields_list_contains,bat_board_right)
```
